## boards/shields/caveman/Kconfig.defconfig
```kconfig
if SHIELD_CAVEMAN

config ZMK_KEYBOARD_NAME
  default "caveman"

choice ZMK_BOOTMODE_MAGIC_VALUE_BOOTLOADER_TYPE
    default ZMK_BOOTMODE_MAGIC_VALUE_BOOTLOADER_TYPE_TINYUF2

endchoice

endif
```

## boards/weact/stm32h5_core/Kconfig.weact_stm32h5_core
```kconfig
config BOARD_WEACT_STM32H5_CORE
  select ZMK_BOARD_COMPAT
  imply RETAINED_MEM
  imply RETENTION
  imply RETENTION_BOOT_MODE
```

## boards/weact/stm32h5_core/board.yml
```yaml
board:
  extend: weact_stm32h5_core
  variants:
    - name: zmk
      qualifier: stm32h562xx
```

## config/west.yml
```yaml
manifest:
  remotes:
    - name: zmkfirmware
      url-base: https://github.com/zmkfirmware
    - name: mjw6i
      url-base: https://github.com/mjw6i
  projects:
    - name: zmk
      remote: zmkfirmware
      revision: main
      import: app/west.yml
  self:
    path: config
```
